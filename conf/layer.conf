## conf/layer.conf
```bitbake
BBFILES += "${LAYERDIR}/recipes/*/*.bb ${LAYERDIR}/recipes/*/*.bbappend ${LAYERDIR}/recipes-*/*/*.bb ${LAYERDIR}/recipes-*/*/*.bbappend"
BBPATH .= ":${LAYERDIR}"
BBFILE_COLLECTIONS += "audio"
BBFILE_PRIORITY_audio = "20"
BBFILE_PATTERN_audio := "^${LAYERDIR}/"

LAYERSERIES_COMPAT_audio += "kirkstone"

PREFERRED_VERSION_audiodlkm = "${@bb.utils.contains('BASEMACHINE', 'sa410m', '5.15%', '5.4%', d)}"
```
